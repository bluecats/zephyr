## drivers/counter/Kconfig.stm32_tim
```kconfig
# Kconfig - STM32 Cube LL RTC
#
# Copyright (c) 2018, Linaro Limited
#
# SPDX-License-Identifier: Apache-2.0
#

menuconfig COUNTER_TIM_STM32
	bool "STM32 Counter TIM driver"
	depends on SOC_FAMILY_STM32
	select USE_STM32_LL_TIM
	select USE_STM32_LL_PWR
	select USE_STM32_LL_RCC
	select USE_STM32_LL_EXTI
	select NEWLIB_LIBC
	help
	  Build TIM driver for STM32 SoCs. Tested on STM32 F4 series (more to be added...)

config COUNTER_TIM_STM32_TIMER0
	bool "Enable Counter on TIM5"
	depends on COUNTER_TIM_STM32

config COUNTER_TIM_STM32_TIMER1
	bool "Enable Counter on TIM2"
	depends on COUNTER_TIM_STM32
```

## dts/bindings/counter/st,stm32-counter.yaml
```yaml
---
title: STM32 COUNTER
version: 0.1

description: >
    This binding gives a base representation of the STM32 COUNTER

properties:
    compatible:
      constraint: "st,stm32-counter"

    label:
      type: string
      category: required
      description: Human readable string describing the device (used by Zephyr for API name)
      generation: define

...
```

## samples/drivers/counter_rtc/sample.yaml
```yaml
sample:
  name: Counter RTC Driver Sample
tests:
  test:
    tags: drivers
    harness: console
    harness_config:
        type: multi_line
        ordered: true
        regex:
            - "Test Counter RTC driver"
            - "Alarm"
    depends_on: counter
```
